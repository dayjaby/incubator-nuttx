## arch/risc-v/src/litex/Kconfig
```kconfig
#
# For a description of the syntax of this configuration file,
# see the file kconfig-language.txt in the NuttX tools repository.
#

comment "LITEX Configuration Options"

menu "LITEX Peripheral Support"

# These "hidden" settings determine whether a peripheral option is available
# for the selected MCU

config LITEX_HAVE_UART0
	bool
	default y
	select UART0_SERIALDRIVER
	select ARCH_HAVE_SERIAL_TERMIOS

# These are the peripheral selections proper

config LITEX_UART0
	bool "UART0"
	default y
	select ARCH_HAVE_UART0
	select ARCH_HAVE_SERIAL_TERMIOS
	select LITEX_UART

config LITEX_SDMMC
	bool
	default n

config LITEX_SDMMC1
	bool "SDMMC1"
	default n
	select LITEX_SDMMC
	select ARCH_HAVE_SDIO
	select ARCH_HAVE_SDIOWAIT_WRCOMPLETE
	select ARCH_HAVE_SDIO_PREFLIGHT
	select SDIO_BLOCKSETUP

endmenu
```
